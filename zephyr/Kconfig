## zephyr/Kconfig
```kconfig
# SPDX-License-Identifier: Apache-2.0
config SYNAPSE_PB
        bool "Synapse Protobuf Support"
        depends on NANOPB
        help
          This option enables the Synapse Protobuf library.

if SYNAPSE_PB

endif
```
